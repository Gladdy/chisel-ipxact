# badhash: IP-XACT component
VLNV uk.ac.cam.cl::badhash:1.0.0
This component executes the badhash algorithm.

## Address spaces and blocks
badhash_register_map.badhash_address_block: base 0x0, range 0x10, width 32, register

## Registers
Registers are 32-bit, write-only, no defined reset value unless marked. A register's access mark holds for its fields unless they carry their own. Offsets are from the block's base; lines under a group give offsets from that group; [hi:lo] are bit positions; {n}, {i} and the like mark numbered series; 'fields as' and 'values as' point back to an identical list; <NAME> marks a mode.

## badhash_register_map.badhash_address_block — This Address block contains all the registers needed to interact with the badhash device.
Base 0x00000000
0x00 input_data — The input value which will be hashed.
0x08 output_data ro — The output value equal to the badhash of the input.
